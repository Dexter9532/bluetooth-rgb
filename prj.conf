## CMakeLists.txt
```
cmake_minimum_required(VERSION 3.20.0)

find_package(Zephyr REQUIRED HINTS $ENV{ZEPHYR_BASE})
project(bluetooth-app)

target_sources(app PRIVATE
  src/main.c
  src/bluetooth/bluetooth.c
  src/bluetooth/gatt_service.c
  src/rgb/rgb.c
  src/display/display.c
)
include_directories(
  src
)
```

## prj.conf
```kconfig
# GPIO
CONFIG_GPIO=y

# Console / serial
CONFIG_SERIAL=y
CONFIG_CONSOLE=y
CONFIG_UART_CONSOLE=y
CONFIG_PRINTK=y

# Bluetooth
CONFIG_BT=y
CONFIG_BT_PERIPHERAL=y
CONFIG_BT_BROADCASTER=y
CONFIG_BT_DEVICE_NAME="Bobos ESP32-App"
CONFIG_BT_GATT_SERVICE_CHANGED=y
CONFIG_BT_GATT_DYNAMIC_DB=y

# NEOPIXEL
CONFIG_LED_STRIP=y
CONFIG_WS2812_STRIP_SPI=y
CONFIG_SPI=y

# lvgl + display
CONFIG_DISPLAY=y
CONFIG_LVGL=y
CONFIG_LV_Z_AUTO_INIT=y

# memory 
CONFIG_LV_Z_MEM_POOL_SIZE=65536
CONFIG_HEAP_MEM_POOL_SIZE=65536
```

## src/main.c
```c
#include "bluetooth/bluetooth.h"
#include "bluetooth/gatt_service.h"
#include "display/display.h"
#include "rgb/rgb.h"

#include <stdint.h>
#include <zephyr/device.h>
#include <zephyr/drivers/gpio.h>
#include <zephyr/drivers/led_strip.h>
#include <zephyr/kernel.h>
#include <zephyr/sys/printk.h>

#include <zephyr/bluetooth/bluetooth.h>
#include <zephyr/bluetooth/hci.h>

int main(void) {
  int err = bt_enable(bt_ready);

  if (err) {
    printk("Bluetooth enable failed (err %d)\n", err);
  }

  if (!init_rgb()) {
    printk("LED strip not ready\n");
  }

  display_init();
  display_set_value(1);

  uint8_t hex[3];
  uint8_t saved_hex[3] = {0, 0, 0};

  while (true) {

    get_rgb_hex(hex);

    for (uint8_t i = 0; i < 3; i++) {
      if (hex[i] != saved_hex[i]) {
        saved_hex[0] = hex[0];
        saved_hex[1] = hex[1];
        saved_hex[2] = hex[2];
        update_rgb(saved_hex);
        break;
      }
    }

    k_sleep(K_MSEC(50));
  }
}
```
